## drivers/input/keyboard/mediatek/Kconfig
```kconfig
config KEYBOARD_MTK
	tristate "MediaTek Keypad Support"
	---help---
	  Say Y here if you want to use the keypad.
	  If unuse, say N.
	  To compile this driver as a module, choose M here: the
	  module will be called mtk-kpd.

config MTK_VOLUP_LONG_PRESS_PANIC
	bool "MTK Volume Up long press panic debug feature"
	depends on KEYBOARD_MTK
	default n
	help
	  Enable Volume Up key long press panic debug feature for MTK platforms.
	  When enabled, pressing and holding the Volume Up key for 10 seconds
	  will trigger a kernel panic. This is useful for debugging system
	  startup issues such as GSI ROM stuck at logo, and will preserve
	  dmesg logs via ramoops/pstore. Should be disabled in production.

config ONEKEY_REBOOT_NORMAL_MODE
	bool "Long press reboot by Powerkey only on normal mode"
	default n
	---help---
	  Say Y here if you want to use one key reboot normal mode.

	  If unuse, say N.

	  To compile this driver as a module, choose M here: the
	  module will be called long_press_reboot_function_setting.

config TWOKEY_REBOOT_NORMAL_MODE
	bool "Long press reboot by Powerkey + other key on normal mode"
	default n
	---help---
	  Say Y here if you want to use two key reboot noraml mode.

	  If unuse, say N.

	  To compile this driver as a module, choose M here: the
	  module will be called long_press_reboot_function_setting.

config ONEKEY_REBOOT_OTHER_MODE
	bool "Long press reboot by Powerkey only on other mode"
	default n
	---help---
	  Say Y here if you want to use one key reboot other mode.

	  If unuse, say N.

	  To compile this driver as a module, choose M here: the
	  module will be called long_press_reboot_function_setting.

config TWOKEY_REBOOT_OTHER_MODE
	bool "Long press reboot by Powerkey + other key on other mode"
	default n
	---help---
	  Say Y here if you want to use two key reboot other mode.

	  If unuse, say N.

	  To compile this driver as a module, choose M here: the
	  module will be called long_press_reboot_function_setting.

config KPD_PMIC_LPRST_TD
	int "Long press reboot timeout period"
	depends on ONEKEY_REBOOT_NORMAL_MODE || TWOKEY_REBOOT_NORMAL_MODE
	range 0 3
	default "3"
	---help---
	  0->8s, 1->11s, 2->14s, 3->5s

config KPD_PWRKEY_USE_PMIC
	bool "power key use pmic key"
	default n
	---help---
	  Say Y here if you want to use pmic key as power key.

	  If unuse, say N.

	  To compile this driver as a module, choose M here: the
	  module will be called kpd_pmic_pwrkey_hal.

config MTK_MRDUMP_KEY
	bool "MediaTek mrdump reset key support"
	default n
	help
	  Say Y if you want to enable mrdump key SMT item support.

	  If you don't know what to do here, say N.

	  The memory dump key is implemented via eint-rst-key,
	  and used for debug purpose. The circuit layout must
	  have phyiscal eint-rst-key key on the main board.

config LONG_PRESS_MODE_EN
	bool "MediaTek dump reset key support"
	default n
	help
	  Say Y if you want to enable mrdump key SMT item support.

	  If you don't know what to do here, say N.

	  The memory dump key includes power key, homerest key and
	  volume down key, and used for debug purpose.
```
